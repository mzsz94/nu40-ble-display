## kit_selftest/testcase.yaml
```yaml
tests:
  nucode.kit.selftest.build:
    build_only: true
    platform_allow:
      - nucode_nu40/nrf52840
    integration_platforms:
      - nucode_nu40/nrf52840
    tags:
      - gpio
      - display
      - audio
      - disk
```

## nu40_ble_display/testcase.yaml
```yaml
tests:
  bluetooth.nu40.oled_receiver:
    build_only: true
    platform_allow:
      - nucode_nu40/nrf52840
    tags:
      - bluetooth
      - display
```

## west.yml
```yaml
# SPDX-License-Identifier: Apache-2.0
manifest:
  remotes:
    - name: zephyrproject
      url-base: https://github.com/zephyrproject-rtos
  projects:
    - name: zephyr
      remote: zephyrproject
      revision: e70694102ad6f910485155a824c5483daf605a9f
      import: true
  self:
    path: nu40-ble-display
```
